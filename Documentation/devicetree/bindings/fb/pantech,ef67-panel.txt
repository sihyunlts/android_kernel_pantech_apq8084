## Documentation/devicetree/bindings/fb/pantech,ef67-panel.txt
```
Pantech EF67 R63419 dual-DSI panel

With CONFIG_MACH_APQ8084_EF67, the qcom,mdss-vcip-en-gpio property selects
the EF67 power and backlight implementation. The standard MDSS panel
properties are described in mdss-dsi-panel.txt.

Both panel nodes describe the same physical panel and use the following
GPIO properties instead of the controller's qcom,platform-* GPIO properties:

- qcom,mdss-reset-gpio: panel reset, GPIO96, high releases reset.
- qcom,mdss-bl-en-gpio: backlight enable, GPIO26, active high.
- qcom,mdss-vddio-reg-gpio: VDDIO enable, GPIO97, active high.
- qcom,mdss-vcip-en-gpio: positive bias enable, GPIO136, active high.
- qcom,mdss-vcin-en-gpio: negative bias enable, GPIO137, active high.
- qcom,mdss-te-gpio: tearing-effect input, GPIO12.

GPIO flags are zero, matching the stock EF67 device tree. DISPLAY_1 owns
the shared pins; DISPLAY_2 must not request or reset them again. Panel
initialization, shutdown and backlight DCS commands use DISPLAY_1 only,
matching the stock panel. Both controllers carry pixel data.
qcom,mdss-dsi-bl-pmic-control-type must be "bl_ctrl_dcs" and
qcom,mdss-dsi-bl-max-level must be 255.

The stock on/off command sets are required. In particular, the off commands
use "dsi_hs_mode": MDSS sends BLANK before PANEL_OFF
removes shared power. The on commands restore dimming (0x53=0x0c) and
CABC (0x55=0x03 by default). The runtime cabc_ctl interface changes both
the immediate command and the value used in initialization.

qcom,mdss-dsi-cabc-command is the stock HS command packet
[39 01 00 00 00 00 02 55 03]; qcom,mdss-dsi-cabc-command-state must be
"dsi_hs_mode". The on-command set must contain a DCS long write 0x55
with a two-byte payload so the selected CABC mode survives power cycles.

qcom,cont-splash-enabled retains bootloader output levels when continuous
splash is enabled by the MDSS boot configuration. The EF67 power sequence
replaces qcom,mdss-dsi-reset-sequence for this panel.

The board must not install gpiomux active/suspended output levels for these
power/reset/backlight pins: GPIO request/free can apply those levels outside
the panel power sequence. The panel driver configures GPIO26/96/97 when
taking over the outputs; bias-enable pin settings remain as in the bootloader.

The verified supply configuration is IM-A930S S0226114: vdda uses PMA8084 L2
at 1200000 uV and vddio uses PMA8084 L12 at 1800000 uV, without a separate
DSI vdd supply. VCIP/VCIN GPIO values only control enables, not bias voltage
magnitudes. The older IM-A930L firmware has a different supply configuration;
using the same DT in an L build does not establish electrical compatibility.
```

## Documentation/devicetree/bindings/input/atmel-mxt-ef67.txt
```
Pantech EF67 Atmel mXT641T touchscreen

This binding describes the IM-A930S S0226114 board wiring. EF67 S and L
use the same board configuration; L hardware compatibility is unverified.
The driver accepts the stock family 0xa4, variant 0x07, version 0x10,
build 0xaa, 32x20 matrix and 39-object profile. It writes stock finger,
glove or passive-stylus settings to volatile RAM, without rewriting
controller firmware or nonvolatile settings.

Required properties:
- compatible: "atmel,atmel_mxt_641t"
- reg: I2C address 0x4a
- interrupt-parent: GPIO interrupt controller
- interrupts: GPIO143, falling-edge interrupt
- atmel,irq-gpio: GPIO143, active low
- atmel,reset-gpio: GPIO145, driven low during reset
- atmel,iovdd-gpio: GPIO144, driven high to enable digital/I/O power
- avdd-supply: analog supply, 3.3V (PMA8084 L16 on EF67)

Example:

atmel_mxt_fw21@4a {
	compatible = "atmel,atmel_mxt_641t";
	reg = <0x4a>;
	interrupt-parent = <&msmgpio>;
	interrupts = <143 2>;
	atmel,irq-gpio = <&msmgpio 143 0>;
	atmel,reset-gpio = <&msmgpio 145 0>;
	atmel,iovdd-gpio = <&msmgpio 144 0>;
	avdd-supply = <&pma8084_l16>;
};

The board's GPIO mux setup provides the stock IRQ/reset pin settings.
The GPIO flags in the example follow the stock board's raw-level wiring;
the driver uses the legacy GPIO API and explicitly drives reset/power.
See Documentation/ABI/testing/sysfs-driver-ef67-mxt641t for mode selection.
```

## Documentation/devicetree/bindings/input/pantech,ef67-smart-cover.txt
```
Pantech EF67 smart-cover sensor

Required properties:
- compatible: "pantech,ef67-smart-cover"
- child node cover:
  - gpios: sensor GPIO with active-low flag on EF67S (MSM GPIO9)
  - debounce-interval: interval in milliseconds between stable-state samples

The driver reports the stock smart_cover EV_SW/SW_LID input device and
provides /dev/gpio_switch_dev for sensor enable/disable. Wakeup is enabled
while the sensor is enabled. See Documentation/ABI/testing/ef67-stock-controls.

Example:
smart_cover {
	compatible = "pantech,ef67-smart-cover";
	cover {
		gpios = <&msmgpio 9 1>;
		debounce-interval = <10>;
	};
};
```

## drivers/dmb/Kconfig
```kconfig
config EF67_DMB
        bool "Pantech EF67 FC8080 terrestrial DMB"
        depends on MACH_APQ8084_EF67 && SPI
        help
          FC8080 receiver on BLSP1 QUP1, with the stock /dev/tdmb interface.
```

## drivers/switch/Kconfig
```kconfig
menuconfig SWITCH
	tristate "Switch class support"
	help
	  Say Y here to enable switch class support. This allows
	  monitoring switches by userspace via sysfs and uevent.

if SWITCH

config SWITCH_EF67_PEN
	bool "Pantech EF67 pen insertion switch"
	depends on MACH_APQ8084_EF67 && OF && GPIOLIB
	help
	  Report the built-in pen's insertion state through the stock
	  touch_pen_detection switch, including debounce and wakeup.

config SWITCH_GPIO
	tristate "GPIO Swith support"
	depends on GPIOLIB
	help
	  Say Y here to enable GPIO based switch support.

endif # SWITCH
```
